## config/west.yml
```yaml
manifest:
  remotes:
    - name: splitkb
      url-base: https://github.com/splitkb
    # Additional modules containing boards/shields/custom code can be listed here as well
    # See https://docs.zephyrproject.org/3.2.0/develop/west/manifest.html#projects
  projects:
    - name: zmk
      remote: splitkb
      revision: 80cf18d57c52a8ed4badc7f330cec7eada6521d8 # main+halcyon-fixes, 2026-11-04
      import: app/west.yml
    - name: zmk-halcyon-module
      remote: splitkb
      revision: 0b95571b332862a6fda8d62a0f0a4c6ccd7895dc # main, 2026-11-04
  self:
    path: config
```
