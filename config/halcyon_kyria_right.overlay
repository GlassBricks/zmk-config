/*
 * Right side has soldered encoder.
 */
&right_soldered_encoder {
    status = "okay";

    /*
     * This encoder emits 2 pulses per detent, not what default assumes.
     */
    steps = <40>;
};

/*
 * Battery calibration: full charge read 4140-4147 mV (93%) with the nominal
 * 30k/10k divider. Scale so it reads ~4200 mV (100%).
 */
&vbatt {
    full-ohms = <30435>;
};
