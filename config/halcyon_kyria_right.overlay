/*
 * Right side has soldered encoder.
 */
&right_soldered_encoder {
    status = "okay";

    /*
     * This encoder emits 2 pulses per detent, not what default assumes.
     */
    steps = <40>;
};
